// SPDX-License-Identifier: BSD-3-Clause
/*
 * Copyright (c) 2025, Shandorman <98683030+jiganomegsdfdf@users.noreply.github.com>
 */

/dts-v1/;
#include "sm8550-oneplus-aston.dts"

&oplus_mem {
	reg = <0x00 0x80000000 0x00 0xe00000 0x00 0x811d0000 0x00 0x56f90000 0x00 0xd8800000 0x00 0x00 0x00 0xe1bb0000 0x00 0x1e450000 0x08 0x80000000 0x00 0x38700000 0x08 0xc0000000 0x01 0x40000000 0x0a 0x00 0x02 0x00>;
};
