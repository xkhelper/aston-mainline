## drivers/input/touchscreen/synaptics_hbp/Kconfig
```kconfig
#
# Synaptics TCM touchscreen driver configuration
#
menuconfig TOUCHSCREEN_SYNA_TCM2
	tristate "Synaptics TCM touchscreen"
	help
	  Say Y here if you have a Synaptics TCM touchscreen connected
	  to your system.

	  If unsure, say N.

	  To compile this driver as a module, choose M here.

config TOUCHPANEL_CUSTOM
	tristate "custom touchscreen driver"
	help
	  Say Y here if want to add touch custom driver for the built-in touchscreen.

	  If unsure, say N.

	  To compile this driver as a module, choose M here.
```
